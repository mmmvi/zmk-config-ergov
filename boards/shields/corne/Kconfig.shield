## boards/shields/corne/Kconfig.shield
```kconfig
config SHIELD_ERGOV_LEFT
    def_bool $(shields_list_contains,ergov_left)

config SHIELD_ERGOV_RIGHT
    def_bool $(shields_list_contains,ergov_right)
```

## boards/shields/ergov_right/Kconfig.defconfig
```kconfig
if SHIELD_ERGOV_LEFT

config ZMK_KEYBOARD_NAME
    default "ErgoV"

config ZMK_SPLIT_ROLE_CENTRAL
    default y

endif

if SHIELD_ERGOV_LEFT || SHIELD_ERGOV_RIGHT

config ZMK_SPLIT
    default y

endif
```

## boards/shields/evr/Kconfig.defconfig
```kconfig
config ZMK_STUDIO
    default y

if SHIELD_EVL

config ZMK_KEYBOARD_NAME
    default "ErgoV"

config ZMK_SPLIT_ROLE_CENTRAL
    default y

endif

if SHIELD_EVL || SHIELD_EVR

config ZMK_SPLIT
    default y

endif
```

## config/boards/shields/vkey/Kconfig.defconfig
```kconfig
if SHIELD_VKEY_LEFT

# Name must be less than 16 characters long!
config ZMK_KEYBOARD_NAME
    default "VKey"

config ZMK_SPLIT_ROLE_CENTRAL
    default y

endif

if SHIELD_VKEY_LEFT || SHIELD_VKEY_RIGHT

config ZMK_SPLIT
    default y

endif
```

## config/boards/shields/vkey/Kconfig.shield
```kconfig
# No whitespace after the comma or in your part name!
config SHIELD_VKEY_LEFT
    def_bool $(shields_list_contains,vkey_left)

# No whitespace after the comma or in your part name!
config SHIELD_VKEY_RIGHT
    def_bool $(shields_list_contains,vkey_right)
```

## config/west.yml
```yaml
manifest:
  remotes:
    - name: zmkfirmware
      url-base: https://github.com/zmkfirmware
    # Additional modules containing boards/shields/custom code can be listed here as well
    # See https://docs.zephyrproject.org/3.2.0/develop/west/manifest.html#projects
  projects:
    - name: zmk
      remote: zmkfirmware
      revision: c25e927a2fae915e208a8777ce211a10c658e771
      import: app/west.yml
  self:
    path: config
```
